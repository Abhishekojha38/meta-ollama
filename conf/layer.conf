## conf/layer.conf
```bitbake
# We have a conf and classes directory, add to BBPATH
BBPATH .= ":${LAYERDIR}"

# We have recipes-* directories, add to BBFILES
BBFILES += "${LAYERDIR}/recipes-*/*/*.bb \
            ${LAYERDIR}/recipes-*/*/*.bbappend"

BBFILE_COLLECTIONS += "meta-ollama"
BBFILE_PATTERN_meta-ollama = "^${LAYERDIR}/"
BBFILE_PRIORITY_meta-ollama = "10"

# This should only be incremented on significant changes that will
# cause compatibility issues with other layers
LAYERVERSION_meta-ollama = "1"

# Compatible with Yocto releases
LAYERSERIES_COMPAT_meta-ollama = "walnascar scarthgap nanbield mickledore"

# Layer dependencies
LAYERDEPENDS_meta-ollama = "core"
```
